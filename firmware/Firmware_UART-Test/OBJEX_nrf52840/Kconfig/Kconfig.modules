## firmware/Firmware_UART-Test/OBJEX_nrf52840/Kconfig/Kconfig.modules
```kconfig
menu "nrf (C:/ncs/v2.1.0/nrf)"
osource "C:/ncs/v2.1.0/nrf/Kconfig.nrf"
config ZEPHYR_NRF_MODULE
	bool
	default y
endmenu
menu "hostap (C:/ncs/v2.1.0/modules/lib/hostap)"
osource "C:/ncs/v2.1.0/modules/lib/hostap/zephyr/Kconfig"
config ZEPHYR_HOSTAP_MODULE
	bool
	default y
endmenu
menu "mcuboot (C:/ncs/v2.1.0/bootloader/mcuboot)"
osource "$(ZEPHYR_MCUBOOT_KCONFIG)"
config ZEPHYR_MCUBOOT_MODULE
	bool
	default y
endmenu
menu "mbedtls (C:/ncs/v2.1.0/modules/crypto/mbedtls)"
osource "$(ZEPHYR_MBEDTLS_KCONFIG)"
config ZEPHYR_MBEDTLS_MODULE
	bool
	default y
endmenu
menu "trusted-firmware-m (C:/ncs/v2.1.0/modules/tee/tf-m/trusted-firmware-m)"
osource "$(ZEPHYR_TRUSTED_FIRMWARE_M_KCONFIG)"
config ZEPHYR_TRUSTED_FIRMWARE_M_MODULE
	bool
	default y
endmenu
menu "cjson (C:/ncs/v2.1.0/modules/lib/cjson)"
osource "$(ZEPHYR_CJSON_KCONFIG)"
config ZEPHYR_CJSON_MODULE
	bool
	default y
endmenu
menu "azure-sdk-for-c (C:/ncs/v2.1.0/modules/lib/azure-sdk-for-c)"
osource "$(ZEPHYR_AZURE_SDK_FOR_C_KCONFIG)"
config ZEPHYR_AZURE_SDK_FOR_C_MODULE
	bool
	default y
endmenu
menu "memfault-firmware-sdk (C:/ncs/v2.1.0/modules/lib/memfault-firmware-sdk)"
osource "C:/ncs/v2.1.0/modules/lib/memfault-firmware-sdk/ports/zephyr/Kconfig"
config ZEPHYR_MEMFAULT_FIRMWARE_SDK_MODULE
	bool
	default y
endmenu
menu "cirrus-logic (C:/ncs/v2.1.0/modules/hal/cirrus-logic)"
osource "C:/ncs/v2.1.0/modules/hal/cirrus-logic/Kconfig"
config ZEPHYR_CIRRUS_LOGIC_MODULE
	bool
	default y
endmenu
menu "openthread (C:/ncs/v2.1.0/modules/lib/openthread)"
osource "$(ZEPHYR_OPENTHREAD_KCONFIG)"
config ZEPHYR_OPENTHREAD_MODULE
	bool
	default y
endmenu
menu "canopennode (C:/ncs/v2.1.0/modules/lib/canopennode)"
osource "$(ZEPHYR_CANOPENNODE_KCONFIG)"
config ZEPHYR_CANOPENNODE_MODULE
	bool
	default y
endmenu
menu "chre (C:/ncs/v2.1.0/modules/lib/chre)"
osource "C:/ncs/v2.1.0/modules/lib/chre/platform/zephyr/Kconfig"
config ZEPHYR_CHRE_MODULE
	bool
	default y
endmenu
menu "hal_nordic (C:/ncs/v2.1.0/modules/hal/nordic)"
osource "$(ZEPHYR_HAL_NORDIC_KCONFIG)"
config ZEPHYR_HAL_NORDIC_MODULE
	bool
	default y
endmenu
menu "liblc3codec (C:/ncs/v2.1.0/modules/lib/liblc3codec)"
osource "$(ZEPHYR_LIBLC3CODEC_KCONFIG)"
config ZEPHYR_LIBLC3CODEC_MODULE
	bool
	default y
endmenu
menu "littlefs (C:/ncs/v2.1.0/modules/fs/littlefs)"
osource "$(ZEPHYR_LITTLEFS_KCONFIG)"
config ZEPHYR_LITTLEFS_MODULE
	bool
	default y
endmenu
menu "loramac-node (C:/ncs/v2.1.0/modules/lib/loramac-node)"
osource "$(ZEPHYR_LORAMAC_NODE_KCONFIG)"
config ZEPHYR_LORAMAC_NODE_MODULE
	bool
	default y
endmenu
menu "lvgl (C:/ncs/v2.1.0/modules/lib/gui/lvgl)"
osource "C:/ncs/v2.1.0/modules/lib/gui/lvgl/zephyr/Kconfig"
config ZEPHYR_LVGL_MODULE
	bool
	default y
endmenu
menu "lz4 (C:/ncs/v2.1.0/modules/lib/lz4)"
osource "$(ZEPHYR_LZ4_KCONFIG)"
config ZEPHYR_LZ4_MODULE
	bool
	default y
endmenu
menu "nanopb (C:/ncs/v2.1.0/modules/lib/nanopb)"
osource "$(ZEPHYR_NANOPB_KCONFIG)"
config ZEPHYR_NANOPB_MODULE
	bool
	default y
endmenu
menu "picolibc (C:/ncs/v2.1.0/modules/lib/picolibc)"
osource "C:/ncs/v2.1.0/modules/lib/picolibc/zephyr/Kconfig"
config ZEPHYR_PICOLIBC_MODULE
	bool
	default y
endmenu
menu "TraceRecorder (C:/ncs/v2.1.0/modules/debug/TraceRecorder)"
osource "C:/ncs/v2.1.0/modules/debug/TraceRecorder/kernelports/Zephyr/Kconfig"
config ZEPHYR_TRACERECORDER_MODULE
	bool
	default y
endmenu
menu "zcbor (C:/ncs/v2.1.0/modules/lib/zcbor)"
osource "$(ZEPHYR_ZCBOR_KCONFIG)"
config ZEPHYR_ZCBOR_MODULE
	bool
	default y
endmenu
menu "zscilib (C:/ncs/v2.1.0/modules/lib/zscilib)"
osource "C:/ncs/v2.1.0/modules/lib/zscilib/Kconfig.zscilib"
config ZEPHYR_ZSCILIB_MODULE
	bool
	default y
endmenu
menu "nrfxlib (C:/ncs/v2.1.0/nrfxlib)"
osource "C:/ncs/v2.1.0/nrfxlib/Kconfig.nrfxlib"
config ZEPHYR_NRFXLIB_MODULE
	bool
	default y
endmenu
menu "connectedhomeip (C:/ncs/v2.1.0/modules/lib/matter)"
osource "C:/ncs/v2.1.0/modules/lib/matter/config/nrfconnect/chip-module/Kconfig"
config ZEPHYR_CONNECTEDHOMEIP_MODULE
	bool
	default y
endmenu
```

## firmware/Firmware_UART-Test/OBJEX_nrf52840/Kconfig/Kconfig.shield
```kconfig
osource "e:/GithubRepository/nRF52840_TestBoard/code/boards/shields/*/Kconfig.shield"
osource "C:/ncs/v2.1.0/nrf/boards/shields/*/Kconfig.shield"
```

## firmware/Firmware_UART-Test/OBJEX_nrf52840/Kconfig/Kconfig.shield.defconfig
```kconfig
osource "e:/GithubRepository/nRF52840_TestBoard/code/boards/shields/*/Kconfig.defconfig"
osource "C:/ncs/v2.1.0/nrf/boards/shields/*/Kconfig.defconfig"
```

## firmware/boards/arm/objex_nrf52840/Kconfig.board
```kconfig
# Copyright (c) 2022 Nordic Semiconductor ASA
# SPDX-License-Identifier: Apache-2.0

config BOARD_OBJEX_NRF52840
	bool "OBJEX_nRF52840"
	depends on SOC_NRF52840_QIAA
	
```

## firmware/boards/arm/objex_nrf52840/Kconfig.defconfig
```kconfig
# Copyright (c) 2022 Nordic Semiconductor ASA
# SPDX-License-Identifier: Apache-2.0

if BOARD_OBJEX_NRF52840

config BOARD
	default "objex_nrf52840"

config BT_CTLR
   default BT

endif
```
